## examples/esp-stickc/main/Kconfig.projbuild
```kconfig
menu "OpenClaw Example"

config STICKC_LCD_DRAW_BUF_HEIGHT
    int "LCD draw buffer height in pixels"
    default 20
    help
        Number of pixel rows to allocate for the LVGL draw buffer.
        Higher values use more RAM but reduce display-tearing artifacts.

endmenu
```

## examples/esp-stickc/sdkconfig.defaults
```kconfig
CONFIG_IDF_TARGET="esp32"

CONFIG_LOG_DEFAULT_LEVEL_INFO=y
CONFIG_ESP_SYSTEM_PANIC_PRINT_HALT=y

# M5StickC Plus2: 8 MB flash, 2 MB PSRAM (ESP32-PICO-V3-02).
CONFIG_ESPTOOLPY_FLASHSIZE_8MB=y
CONFIG_ESPTOOLPY_FLASHSIZE="8MB"
CONFIG_SPIRAM=y

# Custom partition table for the M5StickC Plus2.
CONFIG_PARTITION_TABLE_CUSTOM=y
CONFIG_PARTITION_TABLE_CUSTOM_FILENAME="partitions.csv"

# ST7789 display needs a reasonable draw buffer.
# 135 pixels wide * 20 rows * 2 bytes/pixel = 5400 bytes.
CONFIG_STICKC_LCD_DRAW_BUF_HEIGHT=20

# Font and LVGL tuning for the 135x240 screen.
CONFIG_LV_FONT_MONTSERRAT_14=y
CONFIG_LV_FONT_MONTSERRAT_16=y
CONFIG_LV_MEM_SIZE_KILOBYTES=32
CONFIG_LV_BUILD_EXAMPLES=n
CONFIG_LV_BUILD_DEMOS=n

# TLS 1.3 and certificate bundle for gateway connections.
CONFIG_MBEDTLS_CERTIFICATE_BUNDLE=y
CONFIG_MBEDTLS_CERTIFICATE_BUNDLE_DEFAULT_FULL=y
CONFIG_MBEDTLS_SSL_PROTO_TLS1_3=y
```
